## config/west.yml
```yaml
manifest:
  remotes:
    - name: zmkfirmware
      url-base: https://github.com/zmkfirmware
    - name: pmw33xx
      url-base: https://github.com/Luberry/zmk.git
  projects:
    # - name: zmk
    #   remote: zmkfirmware
    #   revision: main
    #   import: app/west.yml
    - name: zmk
      remote: pmw33xx
      revision: pmw3389
      import: app/west.yml
  self:
    path: config
```
